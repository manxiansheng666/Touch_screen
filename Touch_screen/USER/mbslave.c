#include "mbslave.h"

uint8_t Tx0_buf[64];	//发送缓冲区
uint16_t OUTREG[20];    ///触摸屏下发的模拟量的数据存储空间，大小根据实际需求调整    06功能码	
uint16_t INREG[20];		//触摸屏查询的下位机模拟量的数据存储空间，大小根据实际需求调整  	04功能码	
uint8_t OUTPUT[40];    //开关量下发的数据存储空间，，，05功能码
uint8_t INPUT[40];     //读取状态到触摸屏指示灯，，，02功能码

uint8_t  const auchCRCHi[] = {
0x00, 0xC1, 0x81, 0x40, 0x01, 0xC0, 0x80, 0x41, 0x01, 0xC0, 0x80, 0x41, 0x00, 0xC1, 0x81,
0x40, 0x01, 0xC0, 0x80, 0x41, 0x00, 0xC1, 0x81, 0x40, 0x00, 0xC1, 0x81, 0x40, 0x01, 0xC0,
0x80, 0x41, 0x01, 0xC0, 0x80, 0x41, 0x00, 0xC1, 0x81, 0x40, 0x00, 0xC1, 0x81, 0x40, 0x01,
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0x00, 0xC1, 0x81, 0x40, 0x01, 0xC0, 0x80, 0x41, 0x01, 0xC0, 0x80, 0x41, 0x00, 0xC1, 0x81,
0x40
} ;

uint8_t  const auchCRCLo[] = {
0x00, 0xC0, 0xC1, 0x01, 0xC3, 0x03, 0x02, 0xC2, 0xC6, 0x06, 0x07, 0xC7, 0x05, 0xC5, 0xC4,
0x04, 0xCC, 0x0C, 0x0D, 0xCD, 0x0F, 0xCF, 0xCE, 0x0E, 0x0A, 0xCA, 0xCB, 0x0B, 0xC9, 0x09,
0x08, 0xC8, 0xD8, 0x18, 0x19, 0xD9, 0x1B, 0xDB, 0xDA, 0x1A, 0x1E, 0xDE, 0xDF, 0x1F, 0xDD,
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0x44, 0x84, 0x85, 0x45, 0x87, 0x47, 0x46, 0x86, 0x82, 0x42, 0x43, 0x83, 0x41, 0x81, 0x80,
0x40
} ;

//16位CRC校验函数,查表法
uint16_t crc16(uint8_t *puchMsg,uint16_t usDataLen) 	
{ 											
	uint8_t CRCHi = 0xFF ; 				
	uint8_t CRCLo = 0xFF ; 				
	uint16_t uIndex ; 							
	while (usDataLen--) 					
	{
		uIndex = CRCHi ^ *puchMsg++ ; 	
		CRCHi = CRCLo ^ auchCRCHi[uIndex] ;
		CRCLo = auchCRCLo[uIndex] ;
	}
	return (((uint16_t)(CRCLo) << 8) | CRCHi) ;
}

void modbus_process(uint8_t *Rx0_buf,uint8_t len,uint8_t station_addr)
{
	if(len < 8)			//收到的数据少于8个，不是完整的帧
		return;
	if(crc16(Rx0_buf,len) != 0x00)		//crc校验不通过
		return;
	if(station_addr != Rx0_buf[0])	//不是本站的数据，不处理
		return;
	uint8_t addrtemp;
	uint8_t lenthtemp;
	uint8_t Tx0_nums;
	uint16_t crc_end;
	uint8_t tmp_bits;
	uint8_t tmp_bytes;
	uint8_t j = 0;
	uint8_t Function = Rx0_buf[1];	//获取功能码
	uint8_t Rx0_addr=((uint16_t)Rx0_buf[2]<<8)+Rx0_buf[3];	
	uint8_t Rx0_lenth=((uint16_t)Rx0_buf[4]<<8)+Rx0_buf[5];	
	switch(Function)
	{
		case 0x01:
			addrtemp=Rx0_addr/8;
			lenthtemp=Rx0_lenth/8;//位 字节数
			Tx0_nums=lenthtemp+5;
			Tx0_buf[0]= Rx0_buf[0];
            Tx0_buf[1]= Rx0_buf[1];
            Tx0_buf[2]= lenthtemp;
			j = 3;
			for(uint8_t i=0;i<lenthtemp;i++)
			{
				Tx0_buf[j]=OUTPUT[addrtemp++];
				j++;
			}	  
			crc_end=crc16(Tx0_buf,j);				//校验
			Tx0_buf[j++]=crc_end%256;				//校验低位
			Tx0_buf[j++]=crc_end/256;				//校验高位
			uart2_send_by485(Tx0_buf,Tx0_nums);
			break;
			
		case 0x02:
			addrtemp=Rx0_addr/8;
			lenthtemp=Rx0_lenth/8;//位 字节数
			Tx0_nums=lenthtemp+5;
			Tx0_buf[0]= Rx0_buf[0];
            Tx0_buf[1]= Rx0_buf[1];
            Tx0_buf[2]= lenthtemp;
			j=3;
			for(uint8_t i=0;i<lenthtemp;i++)
			{
				Tx0_buf[j]=INPUT[addrtemp+i];
				j++;
			}	  
			crc_end=crc16(Tx0_buf,j);				//校验
			Tx0_buf[j++]=crc_end%256;				//校验低位
			Tx0_buf[j++]=crc_end/256;				//校验高位
			uart2_send_by485(Tx0_buf,Tx0_nums);
			break;
			
		case 0x03:
			lenthtemp=Rx0_lenth*2;
		    Tx0_nums=lenthtemp+5;
			Tx0_buf[0]= Rx0_buf[0];
            Tx0_buf[1]= Rx0_buf[1];
            Tx0_buf[2]= lenthtemp;
            j=3;
			for(uint8_t i = 0;i < Rx0_lenth;i++)	//发送相应字节	
			{							//字高位为0
				Tx0_buf[j]=OUTREG[i+Rx0_addr]/256;
				j++;
				Tx0_buf[j]=OUTREG[i+Rx0_addr]%256;			//字低位为写入字
				j++;
			}   
			crc_end=crc16(Tx0_buf,lenthtemp+3);				//校验
			Tx0_buf[lenthtemp+3]=crc_end%256;				//校验低位
			Tx0_buf[lenthtemp+4]=crc_end/256;				//校验高位
			uart2_send_by485(Tx0_buf,Tx0_nums);
			break;
			
		case 0x04:
			lenthtemp=Rx0_lenth*2;
		    Tx0_nums=lenthtemp+5;
			Tx0_buf[0]= Rx0_buf[0];
            Tx0_buf[1]= Rx0_buf[1];
            Tx0_buf[2]= lenthtemp;
            j=3;
			for(uint8_t i = 0;i < Rx0_lenth;i++)	//发送相应字节	
			{							//字高位为0
				Tx0_buf[j]=INREG[i+Rx0_addr]/256;
				j++;
				Tx0_buf[j]=INREG[i+Rx0_addr]%256;			//字低位为写入字
				j++;
			}   
			crc_end=crc16(Tx0_buf,lenthtemp+3);				//校验
			Tx0_buf[lenthtemp+3]=crc_end%256;				//校验低位
			Tx0_buf[lenthtemp+4]=crc_end/256;				//校验高位
			uart2_send_by485(Tx0_buf,Tx0_nums);
			break;
		
		case 0x05:
			tmp_bytes=Rx0_addr/8;         //最多到255位，只用了低8位
            tmp_bits=Rx0_addr%8;
			if(Rx0_buf[4]==0xff)
			{
				OUTPUT[tmp_bytes]|=(1<<tmp_bits);//flag_switchtmpr[tmp_bytes]|=(1<<tmp_bits);
			}
			else if(Rx0_buf[4]==0x00)
			{
				OUTPUT[tmp_bytes]&=~(1<<tmp_bits);//flag_switchtmpr[tmp_bytes]&=~(1<<tmp_bits);
			}  
			uart2_send_by485(Rx0_buf,len);	//返回收到的数据
			break;
			
		case 0x06:
			OUTREG[Rx0_addr]=(uint16_t)Rx0_buf[4]<<8 | Rx0_buf[5];
			uart2_send_by485(Rx0_buf,len);	//返回收到的数据
			break;
		
		case 0x10:	
			j = 0;
			Tx0_nums=8;
			for(uint8_t i = 0;i < Rx0_lenth;i++)	//发送相应字节	
			{
				OUTREG[i + Rx0_addr]=(uint16_t)Rx0_buf[7+j]<<8 | Rx0_buf[8+j];
   		      	j+=2;
			}
			for(uint8_t i = 0;i < 6;i++)
			{
				Tx0_buf[i] = Rx0_buf[i];
			}
			crc_end=crc16(Tx0_buf,6);				//校验
			Tx0_buf[6]=crc_end%256;				   //校验低位
			Tx0_buf[7]=crc_end/256;				   //校验高位
			uart2_send_by485(Tx0_buf,Tx0_nums);	//返回收到的数据
			break;
		default:
			break;
	}	
}
